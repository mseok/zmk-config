## config/west.yml
```yaml
manifest:
  remotes:
    - name: zmkfirmware
      url-base: https://github.com/zmkfirmware
    # Additional modules containing boards/shields/custom code can be listed here as well
    # See https://docs.zephyrproject.org/3.2.0/develop/west/manifest.html#projects
  projects:
    - name: zmk
      remote: zmkfirmware
      revision: main
      import: app/west.yml
  # The nice_view_gem display shield is vendored locally under boards/shields/
  # (board_root: . in zephyr/module.yml) so its widgets can be customized — e.g.
  # the BT profile shown as a number. It originated from github.com/M165437/nice-view-gem.
  self:
    path: config
```
